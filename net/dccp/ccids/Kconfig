## net/dccp/ccids/Kconfig
```kconfig
# SPDX-License-Identifier: GPL-2.0-only
menu "DCCP CCIDs Configuration"

config IP_DCCP_CCID2_DEBUG
	bool "CCID-2 debugging messages"
	help
	  Enable CCID-2 specific debugging messages.

	  The debugging output can additionally be toggled by setting the
	  ccid2_debug parameter to 0 or 1.

	  If in doubt, say N.

config IP_DCCP_CCID3
	bool "CCID-3 (TCP-Friendly)"
	def_bool y if (IP_DCCP = y || IP_DCCP = m)
	help
	  CCID-3 denotes TCP-Friendly Rate Control (TFRC), an equation-based
	  rate-controlled congestion control mechanism.  TFRC is designed to
	  be reasonably fair when competing for bandwidth with TCP-like flows,
	  where a flow is "reasonably fair" if its sending rate is generally
	  within a factor of two of the sending rate of a TCP flow under the
	  same conditions.  However, TFRC has a much lower variation of
	  throughput over time compared with TCP, which makes CCID-3 more
	  suitable than CCID-2 for applications such streaming media where a
	  relatively smooth sending rate is of importance.

	  CCID-3 is further described in RFC 4342,
	  https://www.ietf.org/rfc/rfc4342.txt

	  The TFRC congestion control algorithms were initially described in
	  RFC 5348.

	  This text was extracted from RFC 4340 (sec. 10.2),
	  https://www.ietf.org/rfc/rfc4340.txt

	  If in doubt, say N.

config IP_DCCP_CCID3_DEBUG
	bool "CCID-3 debugging messages"
	depends on IP_DCCP_CCID3
	help
	  Enable CCID-3 specific debugging messages.

	  The debugging output can additionally be toggled by setting the
	  ccid3_debug parameter to 0 or 1.

	  If in doubt, say N.

config IP_DCCP_TFRC_LIB
	def_bool y if IP_DCCP_CCID3

config IP_DCCP_TFRC_DEBUG
	def_bool y if IP_DCCP_CCID3_DEBUG

config IP_DCCP_CCID5
	bool "CCID 5 (BBR-Like)"
	def_bool y if (IP_DCCP = y || IP_DCCP = m)
	help
	  CCID 5 - BBR implementation for DCCP.
config IP_DCCP_CCID5_DEBUG
	bool "CCID-5 debugging messages"
	depends on IP_DCCP_CCID5
	help
	  Enable CCID-5 specific debugging messages.

	  The debugging output can additionally be toggled by setting the
	  ccid5_debug parameter to 0 or 1.

	  If in doubt, say N.

config IP_DCCP_CCID6
	bool "CCID 6 (Cubic)"
	def_bool y if (IP_DCCP = y || IP_DCCP = m)
	help
	  CCID 6 - BBRv2 implementation for DCCP.
config IP_DCCP_CCID6_DEBUG
	bool "CCID-6 debugging messages"
	depends on IP_DCCP_CCID6
	help
	  Enable CCID-6 specific debugging messages.

	  The debugging output can additionally be toggled by setting the
	  ccid6_debug parameter to 0 or 1.

	  If in doubt, say N.

config IP_DCCP_CCID7
	bool "CCID 7 (Cubic)"
	def_bool y if (IP_DCCP = y || IP_DCCP = m)
	help
	  CCID 7 - Cubic implementation for DCCP.
config IP_DCCP_CCID7_DEBUG
	bool "CCID-7 debugging messages"
	depends on IP_DCCP_CCID7
	help
	  Enable CCID-7 specific debugging messages.

	  The debugging output can additionally be toggled by setting the
	  ccid7_debug parameter to 0 or 1.

	  If in doubt, say N.

endmenu
```

## net/dccp/non_gpl_reordering/Kconfig
```kconfig
# Reordering
menu  "MPDCCP non-gpl advanced reordering control"

config MPDCCP_REORDER_ACTIVE
	tristate "MPDCCP Adaptive Reordering"
	depends on IP_MPDCCP
	help
	  This is an advanced reordering engine. It features means of
	  reordering by introducing a reordering buffer. End-to-end delay
	  increases due to the process of reordering.

endmenu

# The following doesn't work, yet - tbd.
#choice
#	prompt "Default MPDCCP Reordering Engine"
#	default DEFAULT
#	help
#	  Select the Reordering Engine of your choice
#
#	config DEFAULT_REORDER_ADAPTIVE
#		bool "Adaptive Reordering"
#		depends on MPDCCP_REORDER_ADAPTIVE
#
#	config DEFAULT_REORDER_DEQUAL
#		bool "Delay Equalization Reordering"
#		depends on MPDCCP_REORDER_DEQUAL
#
#	config DEFAULT_REORDER_DEFAULT
#		bool "Default (Passive)"
#		---help---
#		  This is the default reordering engine.
#
#endchoice
```

## net/dccp/non_gpl_scheduler/Kconfig
```kconfig
menu "MPDCCP non-gpl scheduler selection"


config MPDCCP_SCHED_CPF
	tristate "MPDCCP Cheapest Path First"
	depends on IP_MPDCCP
	help
	  A priorisation scheduler.

config MPDCCP_SCHED_HANDOVER
	tristate "MPDCCP HANDOVER"
	depends on IP_MPDCCP
	help
	  An HANDOVER Scheduler. It works like CPF scheduler without aggregation.

config MPDCCP_SCHED_ACPF
	tristate "MPDCCP Adaptive Cheapest Path First"
	depends on IP_MPDCCP
	help
	  A version of the CPF scheduler. It utilizes lower priority paths earlier to allow faster aggregation reduced latency.

endmenu
```

## net/dccp/reordering/Kconfig
```kconfig
# Reordering
menu  "MPDCCP advanced reordering control"

endmenu

# The following doesn't work, yet - tbd.
#choice
#	prompt "Default MPDCCP Reordering Engine"
#	default DEFAULT
#	help
#	  Select the Reordering Engine of your choice
#
#	config DEFAULT_REORDER_DEFAULT
#		bool "Default (Passive)"
#		---help---
#		  This is the default reordering engine.
#
#endchoice

config DEFAULT_MPDCCP_REORDER
	string
	depends on IP_MPDCCP
	default "default"
```

## net/dccp/scheduler/Kconfig
```kconfig
menu "MPDCCP scheduler selection"


config MPDCCP_SCHED_SRTT
	tristate "MPDCCP Smoothed RTT"
	depends on IP_MPDCCP
	help
	  A SRTT (Smoothed Round-Trip Time) based scheduler. It will send on the flow 
	  that has the lowest SRTT and is available (i.e., free Congestion Window).

config MPDCCP_SCHED_ROUNDROBIN
	tristate "MPDCCP Round-Robin"
	depends on IP_MPDCCP
	help
	  This is a very simple round-robin scheduler. Probably has bad performance
	  but might be interesting for researchers.

config MPDCCP_SCHED_REDUNDANT
	tristate "MPDCCP Redundant"
	depends on IP_MPDCCP
	help
	  This is a redundant scheduler for latency reduction and higher reliability.
	  Each packet is sent on all available flows.


config MPDCCP_SCHED_OTIAS
	tristate "MPDCCP OTIAS"
	depends on IP_MPDCCP
	help
	  An OTIAS Scheduler. It tries to estimate link latencies and schedules 
	  packets accordingly so that packets arrive in order.

endmenu

if IP_MPDCCP

# The following doesn't work yet - tbd.
#choice
#	prompt "Default MPDCCP Scheduler"
#	default DEFAULT
#	help
#	  Select the prefered default scheduler
#
#	config DEFAULT_SCHED_SRTT
#		bool "Smoothed RTT" if MPDCCP_SCHED_SRTT
#		---help---
#		  This is the SRTT-based scheduler, tries to use the flow with
#		  the lowest SRTT.
#
#	config DEFAULT_SCHED_ROUNDROBIN
#		bool "Round-Robin" if MPDCCP_SCHED_ROUNDROBIN
#		---help---
#		  This is the round-robin scheduler, alternating between flows.
#
#	config DEFAULT_SCHED_REDUNDANT
#		bool "Redundant" if MPDCCP_SCHED_REDUNDANT
#		---help---
#		  This is the redundant scheduler, which sends each packet on
#		  all flows.
#
#	config DEFAULT_SCHED_OTIAS
#		bool "OTIAS" if MPDCCP_SCHED_OTIAS
#		---help---
#		  This is the OTIAS scheduler, it tries to avoid
#	  	  the need for a reordering entity.
#
#endchoice

config DEFAULT_MPDCCP_SCHED
	string
	depends on IP_MPDCCP
#	default "rr" if DEFAULT_SCHED_ROUNDROBIN
#	default "redundant" if DEFAULT_SCHED_REDUNDANT
#	default "srtt" if DEFAULT_SCHED_SRTT
#	default "ratio" if DEFAULT_SCHED_RATIO
#	default "otias" if DEFAULT_SCHED_OTIAS
#	default "cpf" if DEFAULT_SCHED_CPF
#	default "handover" if DEFAULT_SCHED_HANDOVER
	default "default"

endif # IP_MPDCCP
```
